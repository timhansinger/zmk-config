#include <behaviors.dtsi>
#include <dt-bindings/zmk/keys.h>
#if CONFIG_WIRELESS
    #include <dt-bindings/zmk/bt.h>
    #define _BT_SEL_KEYS_ &bt BT_SEL 0 &bt BT_SEL 1 &bt BT_SEL 2 &bt BT_SEL 3 &bt BT_SEL 4
    #define _BT_CLR_KEY_  &bt BT_CLR
#else
    #define _BT_SEL_KEYS_ &trans &trans &trans &trans &trans
    #define _BT_CLR_KEY_  &trans
#endif

#include "../zmk-nodefree-config/helper.h"

#define DEF 0
#define DVORAK 1
#define GAME 2
#define SYM 3
#define FN 4
#define MEDIA 5
#define NUM 6
#define SYS 7
#define MOUSE 8
#define UML 9
#define UMLD 10
#define SWO 11
#define SWOOH 12
#define NAV 13

#include "combos.dtsi"  // requires layer aliases
#include "mouse.dtsi"
#include "extra_keys.h"

#define XXX &none
#define ___ &trans

/* Global settings */

#define QUICK_TAP_MS 175

&sk {  // sticky-key config
    release-after-ms = <900>;  // release after 0.6s
    quick-release;             // no double capitalization when rolling keys
};

&sl {  // sticky-layer config
    ignore-modifiers;          // allow chording sticky mods & layers
};

&lt {  // layer-tap config
    flavor = "balanced";
    tapping-term-ms = <200>;
    quick-tap-ms = <QUICK_TAP_MS>;
};

/* Homerow mods */

/* use helper macros to define left and right hand keys */
#if !defined KEYS_L  // left hand
    #define KEYS_L LT0 LT1 LT2 LT3 LT4 LM0 LM1 LM2 LM3 LM4 LB0 LB1 LB2 LB3 LB4
#endif
#if !defined KEYS_R  // right hand
    #define KEYS_R RT0 RT1 RT2 RT3 RT4 RM0 RM1 RM2 RM3 RM4 RB0 RB1 RB2 RB3 RB4
#endif
#if !defined THUMBS  // thumbs
    #define THUMBS LH2 LH1 LH0 RH0 RH1 RH2
#endif

#define MAKE_HRM(NAME, HOLD, TAP, TRIGGER_POS) \
    ZMK_BEHAVIOR(NAME, hold_tap, \
        flavor = "balanced"; \
        tapping-term-ms = <280>; \
        quick-tap-ms = <QUICK_TAP_MS>; \
        require-prior-idle-ms = <150>; \
        bindings = <HOLD>, <TAP>; \
        hold-trigger-key-positions = <TRIGGER_POS>; \
        hold-trigger-on-release; \
    )

// reuse basic mod-morph scheme
#define SIMPLE_MORPH(NAME, MOD, BINDING1, BINDING2) \
    ZMK_BEHAVIOR(NAME, mod_morph, \
                mods = <(MOD_L ## MOD|MOD_R ## MOD)>; \
                bindings = <BINDING1>, <BINDING2>; \
    )

MAKE_HRM(hml, &kp, &kp, KEYS_R THUMBS)  // left-hand HRMs
MAKE_HRM(hmr, &kp, &kp, KEYS_L THUMBS)  // right-hand HRMs

MAKE_HRM(hml_repeat, &kp, &key_repeat, KEYS_R THUMBS)  // used for HRM-combo
MAKE_HRM(hmr_lpar_lt, &kp, &lpar_lt, KEYS_L THUMBS)    // "    "   "   "
// MAKE_HRM(hmr_rpar_gt, &kp, &rpar_gt, KEYS_L THUMBS)    // "    "   "   "
MAKE_HRM(hmr_rpar_gt_swo, &mo, &rpar_gt, KEYS_L THUMBS)    // "    "   "   "

MAKE_HRM(hml_umlaut, &mo, &kp, KEYS_R THUMBS)  // Umlaut HRMs
MAKE_HRM(hmr_umlaut, &mo, &kp, KEYS_L THUMBS)  // Umlaut HRMs

/* Nav cluster */

// long-tap action on hold, short-tap action on all interrupts
#define MT_CORE \
    flavor = "tap-preferred"; \
    tapping-term-ms = <220>; \
    quick-tap-ms = <220>; \
    hold-trigger-key-positions = <0>;

&mt { MT_CORE };
// ZMK_BEHAVIOR(mt_home, hold_tap, bindings = <&masked_home>, <&kp>; MT_CORE)
// ZMK_BEHAVIOR(mt_end,  hold_tap,  bindings = <&masked_end>, <&kp>; MT_CORE)

// #define NAV_LEFT  &mt LG(LEFT)  LEFT    // tap: left  | long-tap: macOS beginning of line
// #define NAV_RIGHT &mt LG(RIGHT) RIGHT   // tap: right | long-tap: macOS end       of line
// #define NAV_UP    &mt LG(UP)    UP      // tap: up    | long-tap: macOS beginning of document
// #define NAV_DOWN  &mt LG(DOWN)  DOWN    // tap: down  | long-tap: macOS end       of document
#define NAV_LEFT  &kp LEFT
#define NAV_RIGHT &kp RIGHT
#define NAV_UP    &kp UP
#define NAV_DOWN  &kp DOWN
#define NAV_BSPC  &mt LA(BSPC)  BSPC    // tap: bspc  | long-tap: macOS delete word backward
#define NAV_DEL   &mt LA(DEL)   DEL     // tap: del   | long-tap: macOS delete word forward

// CUT / COPY / PASTE / UNDO
ZMK_BEHAVIOR(as_lgui, hold_tap, bindings = <&lgui_key_macro>, <&kp>; MT_CORE)
ZMK_BEHAVIOR(lgui_key_macro, macro_one_param,
    wait-ms = <0>;
    tap-ms = <0>;
    bindings =
        <&macro_press>,
        <&kp LGUI &macro_param_1to1>,
        <&macro_tap>,
        <&kp MACRO_PLACEHOLDER>,
        <&macro_release>,
        <&kp LGUI>;
)

// tap: qmark | shift + tap: excl
SIMPLE_MORPH(qexcl, SFT, &kp QMARK, &kp EXCL)

// ZMK_BEHAVIOR(qexcl, mod_morph,
//     bindings = <&kp QMARK>, <&kp EXCL>;
//     mods = <(MOD_LSFT|MOD_RSFT)>;
// )

ZMK_BEHAVIOR(as_lgui_qexcl, hold_tap, bindings = <&lgui_key_macro>, <&qexcl>; MT_CORE)
ZMK_BEHAVIOR(lgui_key_macro, macro_one_param,
    wait-ms = <0>;
    tap-ms = <0>;
    bindings =
        <&macro_press>,
        <&kp LGUI &macro_param_1to1>,
        <&macro_tap>,
        <&kp MACRO_PLACEHOLDER>,
        <&macro_release>,
        <&kp LGUI>;
)

// qwerty
#define UNDO_Z    &as_lgui Z     Z       // tap: Z   | long-tap: macOS undo
#define CUT_X     &as_lgui X     X       // tap: X   | long-tap: macOS cut
#define COPY_C    &as_lgui C     C       // tap: C   | long-tap: macOS copy
#define PASTE_V   &as_lgui V     V       // tap: V   | long-tap: macOS paste

// dvorak
#define UNDO_QEXCL    &as_lgui_qexcl Z  0     // tap: qexcl | long-tap: macOS undo
#define CUT_Q         &as_lgui X     Q       // tap: Q     | long-tap: macOS undo
#define COPY_J        &as_lgui C     J       // tap: J     | long-tap: macOS undo
#define PASTE_K       &as_lgui V     K       // tap: K     | long-tap: macOS undo

// mask CTRL when holding left/right to avoid accidental jumps to beginning/end of document
// #define MASK_MODS(NAME, MODS, BINDING) \
//     ZMK_BEHAVIOR(NAME, mod_morph, \
//         bindings = <BINDING>, <BINDING>; \
//         mods = <MODS>; \
//     )
// MASK_MODS(masked_home, (MOD_LCTL), &kp HOME)
// MASK_MODS(masked_end,  (MOD_LCTL), &kp END)

/* Caps-word, num-word and smart-mouse */

// tap: sticky-shift | shift + tap/ double-tap: caps-word | hold: shift
ZMK_BEHAVIOR(smart_shft, mod_morph,
    bindings = <&sk LSHFT>, <&caps_word>;
    mods = <(MOD_LSFT)>;
)
&caps_word {  // mods deactivate caps-word, requires PR #1451
    /delete-property/ ignore-modifiers;
};

// tap: num-word | double-tap: sticky num-layer | hold: num-layer
#define SMART_NUM &smart_num NUM 0
ZMK_BEHAVIOR(smart_num, hold_tap,
    flavor = "balanced";
    tapping-term-ms = <200>;
    quick-tap-ms = <QUICK_TAP_MS>;
    bindings = <&mo>, <&num_dance>;
)
ZMK_BEHAVIOR(num_dance, tap_dance,
    tapping-term-ms = <200>;
    bindings = <&num_word>, <&sl NUM>;  // reverse this for sticky-num on single tap
)
&num_word {  // num-word, requires PR #1451
    layers = <NUM>;
    continue-list = <BSPC DEL DOT COMMA PLUS MINUS STAR FSLH EQUAL>;
};

// smart-mouse, requires PR #1366
ZMK_BEHAVIOR(smart_mouse, tri_state,
    bindings = <&tog MOUSE>, <&none>, <&tog MOUSE>;
    ignored-key-positions = <LT1 LT3 RT0 RT1 RT2 RT3 RT4 RM1 RM2 RM3 RB1 RB2 RB3 RH0 RH1>;
    ignored-layers = <MOUSE>;
)

/* Custom behaviors */

// Alt+Tab swapper, requires PR #1366
ZMK_BEHAVIOR(swapper, tri_state,
    bindings = <&kt LGUI>, <&kp TAB>, <&kt LGUI>;
    ignored-key-positions = <LB0 LB1 LB2 LM2 LM3 LT1 LT2 RH0>;
)

// Sticky layer + sticky shift (workaround for issue #1421)
/*
ZMK_BEHAVIOR(sls, sticky_key,
    release-after-ms = <1000>;
    bindings = <&uc_shift>;
    ignore-modifiers;
)
ZMK_BEHAVIOR(uc_shift, macro,
    wait-ms = <0>;
    tap-ms = <1>;
    bindings = <&macro_press &mo UC &kp LSHFT>
             , <&macro_pause_for_release>
             , <&macro_release &mo UC &kp LSHFT>;
)
*/

// tap: comma | shift + tap: semicolon | ctrl + shift + tap: <
SIMPLE_MORPH(comma_morph, SFT, &kp COMMA, &comma_inner_morph)
SIMPLE_MORPH(comma_inner_morph, CTL, &kp SEMICOLON, &kp LESS_THAN)
// ZMK_BEHAVIOR(comma_morph, mod_morph,
//     mods = <(MOD_LSFT|MOD_RSFT)>;
//     bindings = <&kp COMMA>, <&comma_inner_morph>;
// )
// ZMK_BEHAVIOR(comma_inner_morph, mod_morph,
//     bindings = <&kp SEMICOLON>, <&kp LESS_THAN>;
//     mods = <(MOD_LCTL|MOD_RCTL)>;
// )

// tap: dot | shift + tap: colon | ctrl + shift + tap: >
SIMPLE_MORPH(dot_morph, SFT, &kp DOT, &dot_inner_morph)
SIMPLE_MORPH(dot_inner_morph, CTL, &kp COLON, &kp GREATER_THAN)
// ZMK_BEHAVIOR(dot_morph, mod_morph,
//     bindings = <&kp DOT>, <&dot_inner_morph>;
//     mods = <(MOD_LSFT|MOD_RSFT)>;
// )
// ZMK_BEHAVIOR(dot_inner_morph, mod_morph,
//     bindings = <&kp COLON>, <&kp GREATER_THAN>;
//     mods = <(MOD_LCTL|MOD_RCTL)>;
// )

ZMK_BEHAVIOR(kp_kp, hold_tap,
    flavor = "balanced";
    tapping-term-ms = <200>;
    quick-tap-ms = <QUICK_TAP_MS>;
    bindings = <&kp>, <&kp>;
)

ZMK_BEHAVIOR(mo_kp, hold_tap,
    flavor = "balanced";
    tapping-term-ms = <200>;
    quick-tap-ms = <QUICK_TAP_MS>;
    bindings = <&mo>, <&kp>;
)

//// tap: space | shift + tap: return | hold: activate layer
// tap: space | shift + tap: dot -> space -> sticky shift | hold: activate layer
ZMK_BEHAVIOR(lt_spc, hold_tap,
    flavor = "balanced";
    tapping-term-ms = <200>;
    quick-tap-ms = <QUICK_TAP_MS>;
    bindings = <&mo>, <&spc_morph>;
)
ZMK_BEHAVIOR(spc_morph, mod_morph,
    // bindings = <&kp SPACE>, <&dot_spc>;
    bindings = <&kp SPACE>, <&kp BSPC>;
    // bindings = <&kp SPACE>, <&kp RETURN>;
    mods = <(MOD_LSFT|MOD_RSFT)>;
)
ZMK_BEHAVIOR(dot_spc, macro,
    wait-ms = <0>;
    tap-ms = <5>;
    bindings = <&kp DOT &kp SPACE &sk LSHFT>;
)

//dvorak morph

MAKE_HRM(hml_dotmorph, &mo, &dot_morph, KEYS_R THUMBS)  // Umlaut HRMs
MAKE_HRM(hml_commamorph, &mo, &comma_morph, KEYS_R THUMBS)  // Umlaut HRMs


#define HYP LC(LS(LA(LGUI)))
#define MEH LC(LS(LALT))
// tap: sticky hyper | hold: activate layer
ZMK_BEHAVIOR(lt_sk, hold_tap,
    flavor = "balanced";
    tapping-term-ms = <200>;
    quick-tap-ms = <QUICK_TAP_MS>;
    bindings = <&mo>, <&sk>;
)

// Tap: Toggle layer | Hold: Momentary layer toggle
ZMK_BEHAVIOR(mo_tog, hold_tap,
    flavor = "balanced";
    tapping-term-ms = <200>;
    quick-tap-ms = <QUICK_TAP_MS>;
    bindings = <&mo>, <&tog>;
)

// tap: backspace | lshft + tap: delete | rshft + tap: shift-delete
ZMK_BEHAVIOR(bs_del, mod_morph,
    bindings = <&kp BSPC>, <&kp DEL>;
    mods = <(MOD_LSFT|MOD_RSFT)>;
    keep-mods = <MOD_RSFT>;
)

// tap: left-parenthesis | shft + tap: less-than
ZMK_BEHAVIOR(lpar_lt, mod_morph,
    bindings = <&kp LPAR>, <&kp LT>;
    mods = <(MOD_LSFT|MOD_RSFT)>;
)

// tap: right-parenthesis | shft + tap: greater-than
ZMK_BEHAVIOR(rpar_gt, mod_morph,
    bindings = <&kp RPAR>, <&kp GT>;
    mods = <(MOD_LSFT|MOD_RSFT)>;
)

// tap: copy | double-tap: cut
ZMK_BEHAVIOR(copy_cut, tap_dance,
    tapping-term-ms = <200>;
    bindings = <&kp LC(INS)>, <&kp LC(X)>;
)

// Windows sleep key
ZMK_BEHAVIOR(win_sleep, macro,
    wait-ms = <500>;
    tap-ms = <50>;
    bindings = <&kp LG(X) &kp U &kp S>;
)

// German Umlauts on macOS without unicode usage
ZMK_BEHAVIOR(ae_morph, mod_morph,
    bindings = <&umlaut A>, <&shifted_umlaut A>;
    mods = <(MOD_LSFT)>;
    keep-mods = <(MOD_LSFT)>;
)
ZMK_BEHAVIOR(ue_morph, mod_morph,
    bindings = <&umlaut U>, <&shifted_umlaut U>;
    mods = <(MOD_LSFT)>;
    keep-mods = <(MOD_LSFT)>;
)
ZMK_BEHAVIOR(oe_morph, mod_morph,
    bindings = <&umlaut O>, <&shifted_umlaut O>;
    mods = <(MOD_LSFT)>;
    keep-mods = <(MOD_LSFT)>;
)
ZMK_BEHAVIOR(umlaut, macro_one_param,
    wait-ms = <0>;
    tap-ms = <0>;
    bindings =
        <&macro_press>,
        <&kp RALT>,
        <&macro_tap>,
        <&kp U>,
        <&macro_release>,
        <&kp RALT &macro_param_1to1>,
        <&macro_press>,
        <&kp MACRO_PLACEHOLDER>,
        <&macro_pause_for_release>,
        <&macro_param_1to1>,
        <&macro_release>,
        <&kp MACRO_PLACEHOLDER>;
)
ZMK_BEHAVIOR(shifted_umlaut, macro_one_param,
    wait-ms = <0>;
    tap-ms = <0>;
    bindings =
        <&macro_release>,
        <&kp LSHFT>,
        <&macro_press>,
        <&kp RALT>,
        <&macro_tap>,
        <&kp U>,
        <&macro_release>,
        <&kp RALT>,
        <&macro_press>,
        <&kp LSHFT &macro_param_1to1>,
        <&macro_press>,
        <&kp MACRO_PLACEHOLDER>,
        <&macro_pause_for_release>,
        <&macro_param_1to1>,
        <&macro_release>,
        <&kp MACRO_PLACEHOLDER>;
)

// misc aliases
#define CANCEL      &kp K_CANCEL             // cancel caps-word, num-word and smart-mouse

// left hand
#define LT_HM       &hml LSHIFT LT
#define LBKT_HM     &hml LCTRL LBKT
#define LBRC_HM     &hml LALT LBRC
#define LPAR_HM     &hml LGUI LPAR
#define R_UML_HM    &hml_umlaut UML R

// NEW HERE
#define A_UML_HM  &hml_umlaut UML A
#define S_FN_HM  &hml_umlaut FN S
#define F_NAV_HM  &hml_umlaut NAV F
#define D_NUM_HM  &hml_umlaut NUM D
// NEW ENDS HERE

#define W_SWOOH_HM  &hml_umlaut SWOOH W
#define E_NUM_HM    &hml_umlaut NUM E

// dvorak
#define P_UML_HM    &hml_umlaut UMLD P
#define COMMA_SWOOH_HM  &hml_umlaut SWOOH W

// right hand
#define RPAR_HM     &hmr RGUI RPAR
#define RBRC_HM     &hmr RALT RBRC
#define RBKT_HM     &hmr RCTRL RBKT
#define GT_HM       &hmr RSHIFT GT
#define U_UML_HM    &hmr_umlaut UML U
#define I_MEDIA_HM  &hmr_umlaut MEDIA I

//dvorak
#define G_UML_HM    &hmr_umlaut UMLD G
#define C_MEDIA_HM  &hmr_umlaut MEDIA C

// macOS aliases

// tap: Previous Tab | long-tap: Yabai: focus previous window in window tree
#define TAB_WIN_PRV &mt LA(Z)   LS(LG(LBKT))

// tap: Next Tab | long-tap: Yabai: focus next window in window tree
#define TAB_WIN_NXT &mt LA(C)   LS(LG(RBKT))

/* Keymap */

ZMK_CONDITIONAL_LAYER(SYM FN, SYS)  // FN + NUM --> SYS

#define MINS_UML_HM  &hmr_umlaut UML MINUS
#define L_MEDIA_HM  &hmr_umlaut MEDIA L
#define J_SWO_HM  &hmr_umlaut SWO J

// #define S_FN_HM  &hmr_umlaut FN S
// #define D_NAV_HM  &hmr_umlaut NAV D
// #define F_NUM_HM  &hmr_umlaut NUM F

// DEF
ZMK_LAYER(base,
//           FN            UML           NAV           NUM           HYP
// SWOOH, MEDIA, BS, DEL, ESC, TAB
//╭──────╮ ╭─────────────┬─────────────┬─────────────┬─────────────┬─────────────╮ ╭──────╮ ╭─────────────┬─────────────┬─────────────┬─────────────┬─────────────╮ ╭──────╮
//  X_LT     &kp Q         W_SWOOH_HM    E_NUM_HM      R_UML_HM      &kp T           X_MT     &kp Y         U_UML_HM      I_MEDIA_HM    &kp O         &kp P           X_RT
    X_LT     &hml LSHFT Q  &hml LCTRL W  &hml LALT E   &hml LGUI R   &hml MEH T      X_MT     &hmr MEH Y    &hmr RGUI U   &hmr RALT I   &hmr RCTRL O  &hmr RSHFT P    X_RT
//├──────┤ ├─────────────┼─────────────┼─────────────┼─────────────┼─────────────┤ ├──────┤ ├─────────────┼─────────────┼─────────────┼─────────────┼─────────────┤ ├──────┤
//  X_LM     &hml LSHFT A  &hml LCTRL S  &hml LALT D   &hml LGUI F   &hml HYP G      X_MM     &hmr HYP H    &hmr RGUI J   &hmr RALT K   &hmr RCTRL L  &hmr RSHFT MINUS X_RM
    X_LM     A_UML_HM      S_FN_HM       D_NUM_HM      F_NAV_HM      &hml HYP G      X_MM     &hmr HYP H    J_SWO_HM      &kp K         L_MEDIA_HM    MINS_UML_HM     X_RM
//├──────┤ ├─────────────┼─────────────┼─────────────┼─────────────┼─────────────┤ ├──────┤ ├─────────────┼─────────────┼─────────────┼─────────────┼─────────────┤ ├──────┤
    X_LB     UNDO_Z        CUT_X         COPY_C        PASTE_V       &kp B           X_MB     &kp N         &kp M         &comma_morph  &dot_morph    &qexcl          X_RB
//├──────┤ ╰─────────────┼─────────────┴─────────────┼─────────────┼─────────────┤ ├──────┤ ├─────────────┼─────────────┼─────────────┴───────────────────────────╯ ├──────┤
//  X_LH                                             &kp_kp LCTRL ESC &lt_spc SYM 0  X_MH     &kp LSHIFT    &lt_spc FN 0                                              X_RH
    X_LH                                             &kp_kp LCTRL ESC &lt_spc SYM 0  X_MH     &kp LSHIFT    HYP                                                       X_RH
//╰──────╯                                           ╰─────────────┴─────────────╯ ╰──────╯ ╰─────────────┴─────────────╯                                           ╰──────╯
)

// DVORAK
ZMK_LAYER(dvorak,
//  ;,.py  fgcrl
//  aoeui  dhtns
//  'qjkx  bmwvz
//╭──────╮ ╭─────────────┬─────────────┬─────────────┬─────────────┬─────────────╮ ╭──────╮ ╭─────────────┬─────────────┬─────────────┬─────────────┬─────────────╮ ╭──────╮
    X_LT   &kp MINUS &hml_commamorph SWOOH 0 &hml_dotmorph NUM 0 P_UML_HM &kp Y      X_MT     &kp F         G_UML_HM      C_MEDIA_HM    &kp R         &kp L           X_RT
//├──────┤ ├─────────────┼─────────────┼─────────────┼─────────────┼─────────────┤ ├──────┤ ├─────────────┼─────────────┼─────────────┼─────────────┼─────────────┤ ├──────┤
    X_LM     &hml LSHFT A  &hml LCTRL O  &hml LALT E   &hml LGUI U   &hml HYP I      X_MM     &hmr HYP D    &hmr RGUI H   &hmr RALT T   &hmr RCTRL N  &hmr RSHFT S    X_RM
//├──────┤ ├─────────────┼─────────────┼─────────────┼─────────────┼─────────────┤ ├──────┤ ├─────────────┼─────────────┼─────────────┼─────────────┼─────────────┤ ├──────┤
    X_LB     UNDO_QEXCL    CUT_Q         COPY_J        PASTE_K       &kp X           X_MB     &kp B         &kp M         &kp W         &kp V         &kp Z           X_RB
//├──────┤ ╰─────────────┼─────────────┴─────────────┼─────────────┼─────────────┤ ├──────┤ ├─────────────┼─────────────┼─────────────┴───────────────────────────╯ ├──────┤
    X_LH                                             &kp_kp LCTRL ESC &lt_spc SYM 0  X_MH     &kp LSHIFT    &lt_sk FN HYP                                             X_RH
//╰──────╯                                           ╰─────────────┴─────────────╯ ╰──────╯ ╰─────────────┴─────────────╯                                           ╰──────╯
)

// GAME
ZMK_LAYER(game,
//╭──────╮ ╭─────────────┬─────────────┬─────────────┬─────────────┬─────────────╮ ╭──────╮ ╭─────────────┬─────────────┬─────────────┬─────────────┬─────────────╮ ╭──────╮
    X_LTG    &kp Q         &kp W         &kp E         &kp R         &kp T           X_MT     &kp Y         &kp U         &kp I         &kp O         &kp P           X_RTG
//├──────┤ ├─────────────┼─────────────┼─────────────┼─────────────┼─────────────┤ ├──────┤ ├─────────────┼─────────────┼─────────────┼─────────────┼─────────────┤ ├──────┤
    X_LMG    &kp A         &kp S         &kp D         &kp F         &kp G           X_MM     &kp H         &kp J         &kp K         &kp L         &kp MINUS       X_RM
//├──────┤ ├─────────────┼─────────────┼─────────────┼─────────────┼─────────────┤ ├──────┤ ├─────────────┼─────────────┼─────────────┼─────────────┼─────────────┤ ├──────┤
    X_LB     &kp Z         &kp X         &kp C         &kp V         &kp B           X_MB     &kp N         &kp M         &comma_morph  &dot_morph    &qexcl          X_RB
//├──────┤ ╰─────────────┼─────────────┴─────────────┼─────────────┼─────────────┤ ├──────┤ ├─────────────┼─────────────┼─────────────┴───────────────────────────╯ ├──────┤
    X_LH                                             &mo_kp SYM ESC  &kp SPACE       X_MH     &kp LSHIFT    &lt_sk FN HYP                                             X_RH
//╰──────╯                                           ╰─────────────┴─────────────╯ ╰──────╯ ╰─────────────┴─────────────╯                                           ╰──────╯
)

// SYM
ZMK_LAYER(sym,
//   !+&|=@
// <[{('")}]>
// `^#?~\/*$%
//╭──────╮ ╭─────────────┬─────────────┬─────────────┬─────────────┬─────────────╮ ╭──────╮ ╭─────────────┬─────────────┬─────────────┬─────────────┬─────────────╮ ╭──────╮
    X_LT     XXX           &kp UNDER     &kp EXCL      &kp PLUS      &kp AMPS        X_MT     &kp PIPE      &kp MINUS     &kp EQUAL     &kp AT        XXX             X_RT
//├──────┤ ├─────────────┼─────────────┼─────────────┼─────────────┼─────────────┤ ├──────┤ ├─────────────┼─────────────┼─────────────┼─────────────┼─────────────┤ ├──────┤
    X_LM     LT_HM         LBKT_HM       LBRC_HM       LPAR_HM       &kp DQT         X_MM     &kp SQT       RPAR_HM       RBRC_HM       RBKT_HM       GT_HM           X_RM
//├──────┤ ├─────────────┼─────────────┼─────────────┼─────────────┼─────────────┤ ├──────┤ ├─────────────┼─────────────┼─────────────┼─────────────┼─────────────┤ ├──────┤
    X_LB     &kp GRAVE     &kp CARET     &kp HASH      &kp QMARK     &kp TILDE       X_MB     &kp BSLH      &kp SLASH     &kp ASTRK     &kp DOLLAR    &kp PERCENT     X_RB
//├──────┤ ╰─────────────┼─────────────┴─────────────┼─────────────┼─────────────┤ ├──────┤ ├─────────────┼─────────────┼─────────────┴───────────────────────────╯ ├──────┤
    X_LH                                               ___           ___             X_MH     ___           ___                                                       X_RH
//╰──────╯                                           ╰─────────────┴─────────────╯ ╰──────╯ ╰─────────────┴─────────────╯                                           ╰──────╯
)                                                                                                // TODO: SWITCH CANCEL

// FN
ZMK_LAYER(fn,
//╭──────╮ ╭─────────────┬─────────────┬─────────────┬─────────────┬─────────────╮ ╭──────╮ ╭─────────────┬─────────────┬─────────────┬─────────────┬─────────────╮ ╭──────╮
    X_LT     &kp LSHFT     &kp LCTRL     &kp LALT      &kp LGUI      XXX             X_MT     XXX           &kp F7        &kp F8        &kp F9        &kp F10         X_RT
//├──────┤ ├─────────────┼─────────────┼─────────────┼─────────────┼─────────────┤ ├──────┤ ├─────────────┼─────────────┼─────────────┼─────────────┼─────────────┤ ├──────┤
    X_LM     XXX           XXX           XXX           XXX           XXX             X_MM     XXX           &kp F4        &kp F5        &kp F6        &kp F11         X_RM
//├──────┤ ├─────────────┼─────────────┼─────────────┼─────────────┼─────────────┤ ├──────┤ ├─────────────┼─────────────┼─────────────┼─────────────┼─────────────┤ ├──────┤
    X_LB     XXX           XXX           XXX           XXX           XXX             X_MB     XXX           &kp F1        &kp F2        &kp F3        &kp F12         X_RB
//├──────┤ ╰─────────────┼─────────────┴─────────────┼─────────────┼─────────────┤ ├──────┤ ├─────────────┼─────────────┼─────────────┴───────────────────────────╯ ├──────┤
    X_LH                                               ___           ___             X_MH     ___           ___                                                       X_RH
//╰──────╯                                           ╰─────────────┴─────────────╯ ╰──────╯ ╰─────────────┴─────────────╯                                           ╰──────╯
)

// MEDIA
ZMK_LAYER(media,
//╭──────╮ ╭─────────────┬─────────────┬─────────────┬─────────────┬─────────────╮ ╭──────╮ ╭─────────────┬─────────────┬─────────────┬─────────────┬─────────────╮ ╭──────╮
    X_LT     XXX           XXX           &kp C_VOL_UP  XXX           XXX             X_MT     XXX           XXX           XXX           XXX           XXX             X_RT
//├──────┤ ├─────────────┼─────────────┼─────────────┼─────────────┼─────────────┤ ├──────┤ ├─────────────┼─────────────┼─────────────┼─────────────┼─────────────┤ ├──────┤
    X_LM     XXX           XXX           &kp C_VOL_DN  &kp C_MUTE    XXX             X_MM     XXX           XXX           XXX           XXX           XXX             X_RM
//├──────┤ ├─────────────┼─────────────┼─────────────┼─────────────┼─────────────┤ ├──────┤ ├─────────────┼─────────────┼─────────────┼─────────────┼─────────────┤ ├──────┤
    X_LB     XXX           &kp C_PREV    &kp C_PP      &kp C_NEXT    XXX             X_MB     XXX           XXX           XXX           XXX           XXX             X_RB
//├──────┤ ╰─────────────┼─────────────┴─────────────┼─────────────┼─────────────┤ ├──────┤ ├─────────────┼─────────────┼─────────────┴───────────────────────────╯ ├──────┤
    X_LH                                               ___           ___             X_MH     ___           ___                                                       X_RH
//╰──────╯                                           ╰─────────────┴─────────────╯ ╰──────╯ ╰─────────────┴─────────────╯                                           ╰──────╯
)

// NUM
ZMK_LAYER(num,
//╭──────╮ ╭─────────────┬─────────────┬─────────────┬─────────────┬─────────────╮ ╭──────╮ ╭─────────────┬─────────────┬─────────────┬─────────────┬─────────────╮ ╭──────╮
    X_LT     &kp LSHFT     &kp LCTRL     &kp LALT      &kp LGUI      &kp LS(LGUI)    X_MT     &kp N0        &kp N7        &kp N8        &kp N9        XXX             X_RT
//├──────┤ ├─────────────┼─────────────┼─────────────┼─────────────┼─────────────┤ ├──────┤ ├─────────────┼─────────────┼─────────────┼─────────────┼─────────────┤ ├──────┤
//  X_LM     &kp LSHFT     &kp LCTRL   &hml LALT STAR &hml LGUI PLUS &kp EQUAL       X_MM     &kp N0        &kp N4        &kp N5        &kp N6        &comma_morph    X_RM
    X_LM     XXX           XXX           XXX           &kp LS(LGUI)  XXX             X_MM     &kp N0        &kp N4        &kp N5        &kp N6        &comma_morph    X_RM
//├──────┤ ├─────────────┼─────────────┼─────────────┼─────────────┼─────────────┤ ├──────┤ ├─────────────┼─────────────┼─────────────┼─────────────┼─────────────┤
    X_LB     XXX           XXX           &kp FSLH     &hml LS(LGUI) MINUS XXX        X_MB     &kp N0        &kp N1        &kp N2        &kp N3        &dot_morph      X_RB
//                                                    LS(LGUI) for macOS screen capture using N3/N4/N5
//├──────┤ ╰─────────────┼─────────────┴─────────────┼─────────────┼─────────────┤ ├──────┤ ├─────────────┼─────────────┼─────────────┴───────────────────────────╯ ├──────┤
    X_LH                                               ___           ___             X_MH     ___           &kp N0                                                    X_RH
//╰──────╯                                           ╰─────────────┴─────────────╯ ╰──────╯ ╰─────────────┴─────────────╯                                           ╰──────╯
)

// SYS
ZMK_LAYER(sys,
//╭──────╮ ╭─────────────┬─────────────┬─────────────┬─────────────┬─────────────╮ ╭──────╮ ╭─────────────┬─────────────┬─────────────┬─────────────┬─────────────╮ ╭──────╮
    X_LT     _BT_CLR_KEY_  XXX           XXX           XXX           XXX             X_MT     XXX           XXX           XXX           XXX           XXX             X_RT
//├──────┤ ├─────────────┼─────────────┼─────────────┼─────────────┼─────────────┤ ├──────┤ ├─────────────┼─────────────┼─────────────┼─────────────┼─────────────┤ ├──────┤
    X_LM                                _BT_SEL_KEYS_                                X_MM     XXX           &to DEF       &to DVORAK    &to GAME      XXX             X_RM
//├──────┤ ├─────────────┼─────────────┼─────────────┼─────────────┼─────────────┤ ├──────┤ ├─────────────┼─────────────┼─────────────┼─────────────┼─────────────┤ ├──────┤
    X_LB     XXX           XXX           XXX           &sys_reset    &bootloader     X_MB     &bootloader   &sys_reset    XXX           XXX           XXX             X_RB
//├──────┤ ╰─────────────┼─────────────┴─────────────┼─────────────┼─────────────┤ ├──────┤ ├─────────────┼─────────────┼─────────────┴───────────────────────────╯ ├──────┤
    X_LH                                               ___           ___             X_MH     ___           ___                                                       X_RH
//╰──────╯                                           ╰─────────────┴─────────────╯ ╰──────╯ ╰─────────────┴─────────────╯                                           ╰──────╯
)

// MOUSE
ZMK_LAYER(mouse,
//╭──────╮ ╭─────────────┬─────────────┬─────────────┬─────────────┬─────────────╮ ╭──────╮ ╭─────────────┬─────────────┬─────────────┬─────────────┬─────────────╮ ╭──────╮
    X_LT     XXX           XXX           XXX           XXX           XXX             X_MT     U_WH_L        U_WH_D        U_MS_U         U_WH_U       U_WH_R          X_RT
//├──────┤ ├─────────────┼─────────────┼─────────────┼─────────────┼─────────────┤ ├──────┤ ├─────────────┼─────────────┼─────────────┼─────────────┼─────────────┤ ├──────┤
    X_LM     XXX           XXX           XXX           XXX           XXX             X_MM     XXX           U_MS_L        U_MS_D         U_MS_R       XXX             X_RM
//├──────┤ ├─────────────┼─────────────┼─────────────┼─────────────┼─────────────┤ ├──────┤ ├─────────────┼─────────────┼─────────────┼─────────────┼─────────────┤ ├──────┤
    X_LB     XXX           XXX           XXX           XXX           XXX             X_MB     XXX           &mkp MB4      &mkp MCLK      &mkp MB5     XXX             X_RB
//├──────┤ ╰─────────────┼─────────────┴─────────────┼─────────────┼─────────────┤ ├──────┤ ├─────────────┼─────────────┼─────────────┴───────────────────────────╯ ├──────┤
    X_LH                                               ___           ___             X_MH     &mkp LCLK     &mkp RCLK                                                 X_RH
//╰──────╯                                           ╰─────────────┴─────────────╯ ╰──────╯ ╰─────────────┴─────────────╯                                           ╰──────╯
)
// UML

ZMK_LAYER(umlaut,
//╭──────╮ ╭─────────────┬─────────────┬─────────────┬─────────────┬─────────────╮ ╭──────╮ ╭─────────────┬─────────────┬─────────────┬─────────────┬─────────────╮ ╭──────╮
    X_LT     XXX           XXX           XXX           XXX           XXX             X_MT     XXX           &ue_morph     XXX           &oe_morph     XXX             X_RT
//├──────┤ ├─────────────┼─────────────┼─────────────┼─────────────┼─────────────┤ ├──────┤ ├─────────────┼─────────────┼─────────────┼─────────────┼─────────────┤ ├──────┤
    X_LM     &ae_morph     &kp RA(S)     XXX           XXX           XXX             X_MM     XXX           XXX           XXX           XXX           XXX             X_RM
//├──────┤ ├─────────────┼─────────────┼─────────────┼─────────────┼─────────────┤ ├──────┤ ├─────────────┼─────────────┼─────────────┼─────────────┼─────────────┤ ├──────┤
    X_LB     XXX           XXX           XXX           XXX           XXX             X_MB     XXX           XXX           XXX           XXX           XXX             X_RB
//├──────┤ ╰─────────────┼─────────────┴─────────────┼─────────────┼─────────────┤ ├──────┤ ├─────────────┼─────────────┼─────────────┴───────────────────────────╯ ├──────┤
    X_LH                                               ___           ___             X_MH     ___           ___                                                       X_RH
//╰──────╯                                           ╰─────────────┴─────────────╯ ╰──────╯ ╰─────────────┴─────────────╯                                           ╰──────╯
)

// UMLD
ZMK_LAYER(umlaut_d,
//╭──────╮ ╭─────────────┬─────────────┬─────────────┬─────────────┬─────────────╮ ╭──────╮ ╭─────────────┬─────────────┬─────────────┬─────────────┬─────────────╮ ╭──────╮
    X_LT     XXX           XXX           XXX           XXX           XXX             X_MT     XXX           XXX           XXX           XXX           XXX             X_RT
//├──────┤ ├─────────────┼─────────────┼─────────────┼─────────────┼─────────────┤ ├──────┤ ├─────────────┼─────────────┼─────────────┼─────────────┼─────────────┤ ├──────┤
    X_LM     &ae_morph     &oe_morph     XXX           &ue_morph     XXX             X_MM     XXX           XXX           XXX           XXX           &kp RA(S)       X_RM
//├──────┤ ├─────────────┼─────────────┼─────────────┼─────────────┼─────────────┤ ├──────┤ ├─────────────┼─────────────┼─────────────┼─────────────┼─────────────┤ ├──────┤
    X_LB     XXX           XXX           XXX           XXX           XXX             X_MB     XXX           XXX           XXX           XXX           XXX             X_RB
//├──────┤ ╰─────────────┼─────────────┴─────────────┼─────────────┼─────────────┤ ├──────┤ ├─────────────┼─────────────┼─────────────┴───────────────────────────╯ ├──────┤
    X_LH                                               ___           ___             X_MH     ___           ___                                                       X_RH
//╰──────╯                                           ╰─────────────┴─────────────╯ ╰──────╯ ╰─────────────┴─────────────╯                                           ╰──────╯
)

// Keyboard Maestro Application Switcher Layer
// SWO
ZMK_LAYER(swapper,
//╭──────╮ ╭─────────────┬─────────────┬─────────────┬─────────────┬─────────────╮ ╭──────╮ ╭─────────────┬─────────────┬─────────────┬─────────────┬─────────────╮ ╭──────╮
    X_LT     XXX           XXX           &kp H         &kp Q         XXX             X_MT     XXX           XXX           XXX           XXX           XXX             X_RT
//├──────┤ ├─────────────┼─────────────┼─────────────┼─────────────┼─────────────┤ ├──────┤ ├─────────────┼─────────────┼─────────────┼─────────────┼─────────────┤ ├──────┤
    X_LM     XXX           XXX           &kp LSHFT     &swapper      &kp F           X_MM     XXX           XXX           XXX           XXX           XXX             X_RM

//├──────┤ ├─────────────┼─────────────┼─────────────┼─────────────┼─────────────┤ ├──────┤ ├─────────────┼─────────────┼─────────────┼─────────────┼─────────────┤ ├──────┤
    X_LB     XXX           XXX           &kp K         &kp C         XXX             X_MB     XXX           XXX           XXX           XXX           XXX             X_RB
//├──────┤ ╰─────────────┼─────────────┴─────────────┼─────────────┼─────────────┤ ├──────┤ ├─────────────┼─────────────┼─────────────┴───────────────────────────╯ ├──────┤
    X_LH                                               ___           ___             X_MH     ___           ___                                                       X_RH
//╰──────╯                                           ╰─────────────┴─────────────╯ ╰──────╯ ╰─────────────┴─────────────╯                                           ╰──────╯
)

// Keyboard Maestro Application Switcher Layer
// SWOOH
ZMK_LAYER(one_handed_swapper,
//╭──────╮ ╭─────────────┬─────────────┬─────────────┬─────────────┬─────────────╮ ╭──────╮ ╭─────────────┬─────────────┬─────────────┬─────────────┬─────────────╮ ╭──────╮
    X_LT     XXX           XXX           &kp LSHFT     &swapper      XXX             X_MT     XXX           XXX           XXX           XXX           XXX             X_RT
//├──────┤ ├─────────────┼─────────────┼─────────────┼─────────────┼─────────────┤ ├──────┤ ├─────────────┼─────────────┼─────────────┼─────────────┼─────────────┤ ├──────┤
    X_LM     XXX           XXX           XXX           XXX           XXX             X_MM     XXX           XXX           XXX           XXX           XXX             X_RM

//├──────┤ ├─────────────┼─────────────┼─────────────┼─────────────┼─────────────┤ ├──────┤ ├─────────────┼─────────────┼─────────────┼─────────────┼─────────────┤ ├──────┤
    X_LB     XXX           XXX           XXX           XXX           XXX             X_MB     XXX           XXX           XXX           XXX           XXX             X_RB
//├──────┤ ╰─────────────┼─────────────┴─────────────┼─────────────┼─────────────┤ ├──────┤ ├─────────────┼─────────────┼─────────────┴───────────────────────────╯ ├──────┤
    X_LH                                               ___           ___             X_MH     ___           ___                                                       X_RH
//╰──────╯                                           ╰─────────────┴─────────────╯ ╰──────╯ ╰─────────────┴─────────────╯                                           ╰──────╯
)

//NAV
ZMK_LAYER(nav,
//╭──────╮ ╭─────────────┬─────────────┬─────────────┬─────────────┬─────────────╮ ╭──────╮ ╭─────────────┬─────────────┬─────────────┬─────────────┬─────────────╮ ╭──────╮
    X_LT     &kp LSHFT     &kp LCTRL     &kp LALT      &kp LGUI      &kp LS(LGUI)    X_MT     &kp PG_UP     NAV_BSPC      TAB_WIN_PRV   TAB_WIN_NXT   NAV_DEL         X_RT
//├──────┤ ├─────────────┼─────────────┼─────────────┼─────────────┼─────────────┤ ├──────┤ ├─────────────┼─────────────┼─────────────┼─────────────┼─────────────┤ ├──────┤
    X_LM     XXX           &kp LALT      &kp LGUI      XXX           XXX             X_MM     NAV_LEFT      NAV_DOWN      NAV_UP        NAV_RIGHT     &kp RET         X_RM
//├──────┤ ├─────────────┼─────────────┼─────────────┼─────────────┼─────────────┤ ├──────┤ ├─────────────┼─────────────┼─────────────┼─────────────┼─────────────┤ ├──────┤
    X_LB     XXX           XXX           XXX           XXX           XXX             X_MB     &kp PG_DN     &kp TAB       &kp HOME      &kp END       XXX             X_RB
//├──────┤ ╰─────────────┼─────────────┴─────────────┼─────────────┼─────────────┤ ├──────┤ ├─────────────┼─────────────┼─────────────┴───────────────────────────╯ ├──────┤
    X_LH                                               ___           ___             X_MH     ___           ___                                                       X_RH
//╰──────╯                                           ╰─────────────┴─────────────╯ ╰──────╯ ╰─────────────┴─────────────╯                                           ╰──────╯
)

/* vim: set ft=c tw=174: */
