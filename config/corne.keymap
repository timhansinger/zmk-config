/* source keypos definitions */
#include "../zmk-nodefree-config/keypos_def/keypos_42keys.h"

/* map Zen's extra keys */
#define X_LT  &none         // top row, left
#define X_LM  &kp ESC       // middle row, left
#define X_LB  &none         // bottom row, left
#define X_RT  &none         // top row, right
#define X_RM  &kp RET       // middle row, right
#define X_RB  &none         // bottom row, right

#define X_LH  &none         // thumb row, left
#define X_RH  &mo FN        // thumb row, right

// Special for GAME layer
#define X_LTG &kp TAB       // top row, left, GAME layer
#define X_LMG &kp LSHIFT    // middle row, left, GAME layer
#define X_RTG &kp BSPC      // top row, right, GAME layer

/* activate bluetooth */
#define CONFIG_WIRELESS 1

/* Definition for Corne (6-column layout) */
#define KEYS_L LT0 LT1 LT2 LT3 LT4 LT5 LM0 LM1 LM2 LM3 LM4 LM5 LB0 LB1 LB2 LB3 LB4 LB5  // left hand
#define KEYS_R RT0 RT1 RT2 RT3 RT4 RT5 RM0 RM1 RM2 RM3 RM4 RM5 RB0 RB1 RB2 RB3 RB4 RB5  // right hand
#define THUMBS LH2 LH1 LH0 RH0 RH1 RH2                                                  // thumbs

/* source the main keymap */
#include "base.keymap"

/* use 5-column layout for Zen */
// / { chosen { zmk,matrix_transform = &five_column_transform; }; };

/* vim: set ft=c tw=174: */
